/*
 * oled_ssd1306.c
 *
 *  Created on: 26-Dec-2025
 *      Author: sreer
 */

#include "oled_ssd1306.h"
#include "rtc.h"
#include "stm32f446xx.h"
#include <stdint.h>
#include <stdio.h>

// Simple 5x7 Font (ASCII 32-127)
const uint8_t Font5x7[][5] = {
    {0x00, 0x00, 0x00, 0x00, 0x00}, // Space
    {0x00, 0x00, 0x5F, 0x00, 0x00}, // !
    {0x00, 0x07, 0x00, 0x07, 0x00}, // "
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    {0x10, 0x08, 0x08, 0x10, 0x08}  // ~
};

void OLED_Cmd(uint8_t cmd) {
  I2C1->CR1 |= I2C_CR1_START;
  while (!(I2C1->SR1 & I2C_SR1_SB))
    ;
  I2C1->DR = 0x3C << 1;
  while (!(I2C1->SR1 & I2C_SR1_ADDR))
    ;
  (void)I2C1->SR2;

  I2C1->DR = 0x00; // Co=0, D/C#=0 (Command)
  while (!(I2C1->SR1 & I2C_SR1_TXE))
    ;
  I2C1->DR = cmd;
  while (!(I2C1->SR1 & I2C_SR1_BTF))
    ;
  I2C1->CR1 |= I2C_CR1_STOP;
}

void OLED_Data(uint8_t data) {
  I2C1->CR1 |= I2C_CR1_START;
  while (!(I2C1->SR1 & I2C_SR1_SB))
    ;
  I2C1->DR = 0x3C << 1;
  while (!(I2C1->SR1 & I2C_SR1_ADDR))
    ;
  (void)I2C1->SR2;

  I2C1->DR = 0x40; // Co=0, D/C#=1 (Data)
  while (!(I2C1->SR1 & I2C_SR1_TXE))
    ;
  I2C1->DR = data;
  while (!(I2C1->SR1 & I2C_SR1_BTF))
    ;
  I2C1->CR1 |= I2C_CR1_STOP;
}

void OLED_Init(void) {
  uint8_t init_cmds[] = {
      0xAE,       // Display OFF
      0xD5, 0x80, // Set Clock Div Ratio
      0xA8, 0x3F, // Set Multiplex Ratio (64)
      0xD3, 0x00, // Set Display Offset (0)
      0x40,       // Set Start Line (0)
      0x8D, 0x14, // Charge Pump Setting (Enable)
      0x20, 0x00, // Memory Addressing Mode (Horizontal)
      0xA1,       // Segment Re-map (Column 127 mapped to SEG0)
      0xC8,       // COM Output Scan Direction (Remapped)
      0xDA, 0x12, // Set COM Pins Hardware Config
      0x81, 0xCF, // Set Contrast Control
      0xD9, 0xF1, // Set Pre-charge Period
      0xDB, 0x40, // Set VCOMH Deselect Level
      0xA4,       // Entire Display ON (Resume)
      0xA6,       // Normal Display
      0xAF        // Display ON
  };
  for (int i = 0; i < sizeof(init_cmds); i++)
    OLED_Cmd(init_cmds[i]);
  OLED_Clear();
}

void OLED_SetCursor(uint8_t page, uint8_t col) {
  OLED_Cmd(0xB0 + page);
  OLED_Cmd(0x00 + (col & 0x0F));
  OLED_Cmd(0x10 + ((col >> 4) & 0x0F));
}

void OLED_Clear(void) {
  for (uint8_t page = 0; page < 8; page++) {
    OLED_SetCursor(page, 0);
    for (uint8_t col = 0; col < 128; col++) {
      OLED_Data(0x00);
    }
  }
}

void OLED_Char(char c) {
  if (c < 32 || c > 127)
    c = 32;
  for (int i = 0; i < 5; i++) {
    OLED_Data(Font5x7[c - 32][i]);
  }
  OLED_Data(0x00); // Spacing
}

void OLED_String(char *str) {
  while (*str) {
    OLED_Char(*str++);
  }
}

void OLED_Display_Metrics(RTC_Time *time, float t, float rh, int32_t voc) {
  char buf[32];

  OLED_SetCursor(0, 0);
  sprintf(buf, "%02d:%02d:%02d", time->hours, time->minutes, time->seconds);
  OLED_String(buf);

  OLED_SetCursor(2, 0);
  sprintf(buf, "Temp: %.1f C", t);
  OLED_String(buf);

  OLED_SetCursor(3, 0);
  sprintf(buf, "Hum:  %.1f %%", rh);
  OLED_String(buf);

  OLED_SetCursor(4, 0);
  sprintf(buf, "VOC:  %ld", voc);
  OLED_String(buf);
}
